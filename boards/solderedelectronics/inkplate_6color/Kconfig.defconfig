## boards/solderedelectronics/inkplate_6color/Kconfig.defconfig
```kconfig
# Copyright (c) 2025 Fabian Blatz <fabianblatz@gmail.com>
# SPDX-License-Identifier: Apache-2.0

if RTC

config RTC_INIT_PRIORITY
	default 85

endif # RTC
```

## drivers/backlight/Kconfig
```kconfig
# Backlight drivers

# Copyright (c) 2024 Fabian Blatz <fabianblatz@gmail.com>
# SPDX-License-Identifier: Apache-2.0

menuconfig BACKLIGHT
	bool "Backlight Drivers"
	help
	  Enable backlight drivers (e.g. pwm-backlight)

if BACKLIGHT

config BACKLIGHT_INIT_PRIORITY
	int "BACKLIGHT devices init priority"
	default 85
	help
	  BACKLIGHT devices initialization priority.

module = BACKLIGHT
module-str = backlight
source "subsys/logging/Kconfig.template.log_config"

source "drivers/backlight/Kconfig.pwm"

endif # BACKLIGHT
```

## drivers/backlight/Kconfig.pwm
```kconfig
# Copyright (c) 2024 Fabian Blatz
# SPDX-License-Identifier: Apache-2.0

config PWM_BACKLIGHT
	bool "PWM backlight driver"
	default y
	depends on DT_HAS_PWM_BACKLIGHT_ENABLED
	help
	  Enable driver for pwm backlight device.
```

## drivers/display/Kconfig.ac057tc1
```kconfig
# Configuration options for AC057TC1 display

# Copyright (c) 2023 Fabian Blatz <fabianblatz@gmail.com>
# SPDX-License-Identifier: Apache-2.0

config AC057TC1_DISPLAY
	bool "AC057TC1 display driver"
    default y
	depends on DT_HAS_EINK_AC057TC1_ENABLED
	select SPI
	help
	  Enable AC057TC1 display driver.
```

## drivers/sensor/ld2410/Kconfig
```kconfig
# LD2410 hilink radar sensor Configuration options

# Copyright (c) 2021 Linumiz
# SPDX-License-Identifier: Apache-2.0

menuconfig LD2410
	bool "LD2410 radar sensor"
	default y
	depends on DT_HAS_HILINK_LD2410_ENABLED
	depends on SERIAL
	select RING_BUFFER
	help
	  Enable driver for LD2410 Radar Sensor.
```

## drivers/sensor/max3510x/Kconfig
```kconfig
# Copyright (c) 2023 Fabian Blatz
# SPDX-License-Identifier: Apache-2.0

config MAX3510X
	bool "MAX3510X Reduced Power Time-To-Digital converter"
	default y
	depends on DT_HAS_MAXIM_MAX3510X_ENABLED
	select SPI
	help
	  Enable MAX3510X Reduced Power Time-To-Digital converter.
```

## dts/bindings/backlight/backlight-device.yaml
```yaml
# Copyright (c) 2024 Fabian Blatz <fabianblatz@gmail.com>
# SPDX-License-Identifier: Apache-2.0

# Common fields for backlight devices

include: base.yaml

properties:
  default-brightness:
    type: int
    description: |
      The default brightness that should be applied to the LED by the operating
      system on start-up. The brightness should not exceed the brightness the
      LED can provide.

  max-brightness:
    type: int
    description: |
      Normally the maximum brightness is determined by the hardware and this
      property is not required. This property is used to put a software limit
      on the brightness apart from what the driver says, as it could happen
      that a LED can be made so bright that it gets damaged or causes damage
      due to restrictions in a specific system, such as mounting conditions.
```

## dts/bindings/backlight/pwm-backlight.yaml
```yaml
# Copyright (c) 2024 Fabian Blatz <fabianblatz@gmail.com>
# SPDX-License-Identifier: Apache-2.0

include: backlight-device.yaml

description: PWM backlight device

compatible: "pwm-backlight"

properties:
  pwms:
    type: phandle-array
    required: true
    description: |
      Reference to a PWM instance.

  power-supply:
    type: phandle
    description: |
      Regulator for supply voltage

  enable-gpios:
    type: phandle-array
    description: |
      Contains a single GPIO specifier for the GPIO which enables
      and disables the backlight.

  post-pwm-on-delay-ms:
    type: int
    description: |
      Delay in ms between setting an initial (non-zero) PWM
      and enabling the backlight using GPIO.

  pwm-off-delay-ms:
    type: int
    description: |
      Delay in ms between disabling the backlight using GPIO
      and setting PWM value to 0.

  low-threshold-brightness:
    type: int
    description: |
      Lower threshold for brightness.
```

## dts/bindings/display/eink,ac057tc1.yaml
```yaml
# Copyright (c) 2025 Fabian Blatz <fabianblatz@gmail.com>
# SPDX-License-Identifier: Apache-2.0

title: E-Ink AC057TC1 Display Driver

description: |
  Driver for the E-Ink AC057TC1 5.7-inch seven-color electrophoretic display.

compatible: "eink,ac057tc1"

include:
  - display-controller.yaml
  - name: mipi-dbi-spi-device.yaml
    property-blocklist:
      - te-delay

properties:
  busy-gpios:
    type: phandle-array
    description: Busy/status GPIO
```

## dts/bindings/display/zephyr,sdl-dc.yaml
```yaml
# Copyright (c) 2021 Nordic Semiconductor ASA
# SPDX-License-Identifier: Apache-2.0

description: SDL based emulated display controller

compatible: "zephyr,sdl-dc"

include: display-controller.yaml

properties:
  rotation:
    type: int
    default: 0
    enum:
      - 0
      - 90
      - 180
      - 270
    description:
      Display rotation (CW) in degrees.
      If not defined, rotation is off by default.
```

## dts/bindings/input/zephyr,lvgl-button-input.yaml
```yaml
# Copyright 2023 Fabian Blatz <fabianblatz@gmail.com>
# SPDX-License-Identifier: Apache-2.0

description: |
  LVGL button indev pseudo-device

  Listens for button input events and routes the
  lv_indev_data_t to the underlying button lv_indev_t managed by LVGL.

  Needs to be associated to a specific device to listen for events
  from that device. Example configuration:

  pointer {
          compatible = "zephyr,lvgl-button-input";
          input = <&buttons>;
          input-codes = <INPUT_KEY_0>;
          lvgl-key = <10>;
          x-coordinate = <120>;
          y-coordinate = <120>;
  };

compatible: "zephyr,lvgl-button-input"

include: zephyr,lvgl-common-input.yaml

properties:
  input-codes:
    type: array
    required: true
    description: |
      Array of input event key codes (INPUT_KEY_* or INPUT_BTN_*).

  lvgl-key:
    type: int
    required: true
    description: |
      The LVGL LV_KEY_* this button corresponds to.

  x-coordinate:
    type: int
    description: |
      X coordinate of the screen the button is assigned to.

  y-coordinate:
    type: int
    description: |
      Y coordinate of the screen the button is assigned to.
```

## dts/bindings/sensor/hilink,ld2410.yaml
```yaml
# SPDX-License-Identifier: Apache-2.0

description: |
  Hi-Link LD2410 radar sensor

compatible: "hilink,ld2410"

include: [sensor-device.yaml, uart-device.yaml]


properties:
  engineering-mode:
    type: boolean
    description: |
      In this mode the sensor sends additional data.

  distance-resolution:
    type: int
    default: 0
    description: |
      Programmable distance resolution per gate
      0 =  -> 75cm per gate
      1 =  -> 20cm per gate
    enum:
      - 0
      - 1
  
  motion-sensitivity:
    type: array
    default: [50, 50, 40, 30, 20, 15, 15, 15, 15]
    description: |
      Array of 9 motion sensitivty values (0-100 per gate)
  
  stationary-sensitivity:
    type: array
    default: [0, 0, 40, 40, 30, 30, 20, 20, 20]
    description: |
      Array of 9 stationary sensitivty values (0-100 per gate)

  int-gpios:
    type: phandle-array
    required: false
    description: |
      Interrupt pin. When the presence is detected, the GPIO is set to high.
```

## dts/bindings/sensor/maxim,max3510x.yaml
```yaml
# Copyright (c) 2023, Fabian Blatz
# SPDX-License-Identifier: Apache-2.0

description: MAX3510X Reduced Power Time-To-Digital Converter

compatible: "maxim,max3510x"

include: [sensor-device.yaml, spi-device.yaml]

properties:
  irq-gpios:
    type: phandle-array
    description: |
      Interrupt pin, active low

  ref-frequency:
    type: int
    default: 4000000
    description: |
      Input clock frequency

  transducer-distance:
    type: int
    description: |
      Distance between the transducers in millimeters
```

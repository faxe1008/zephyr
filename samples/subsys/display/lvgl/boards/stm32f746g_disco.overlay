/*
 * Copyright (c) 2023, Fabian Blatz <fabianblatz@gmail.com>
 *
 * SPDX-License-Identifier: Apache-2.0
 */

/ {

	input_lvgl_pointer {
		compatible = "zephyr,input-lvgl-pointer";
		input = <&ft5336>;
	};

};

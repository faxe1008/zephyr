## CMakeLists.txt
```
# SPDX-License-Identifier: Apache-2.0

cmake_minimum_required(VERSION 3.20.0)

find_package(Zephyr REQUIRED HINTS $ENV{ZEPHYR_BASE})
project(microui)

FILE(GLOB app_sources src/*.c)
target_sources(app PRIVATE ${app_sources})
```

## prj.conf
```kconfig
CONFIG_DISPLAY=y
CONFIG_LOG=y
```

## src/main.c
```c
#include <stdio.h>
#include <stdlib.h>
#include <string.h>
#include "renderer.h"
#include "microui.h"
#include <zephyr/kernel.h>

static  char logbuf[64000];
static   int logbuf_updated = 0;
static float bg[3] = { 90, 95, 100 };


static void write_log(const char *text) {
  if (logbuf[0]) { strcat(logbuf, "\n"); }
  strcat(logbuf, text);
  logbuf_updated = 1;
}


static void test_window(mu_Context *ctx) {
  /* do window */
  if (mu_begin_window(ctx, "Demo Window", mu_rect(40, 40, 300, 450))) {
    mu_Container *win = mu_get_current_container(ctx);
    win->rect.w = mu_max(win->rect.w, 240);
    win->rect.h = mu_max(win->rect.h, 300);

    /* window info */
    if (mu_header(ctx, "Window Info")) {
      mu_Container *win = mu_get_current_container(ctx);
      char buf[64];
      mu_layout_row(ctx, 2, (int[]) { 54, -1 }, 0);
      mu_label(ctx,"Position:");
      sprintf(buf, "%d, %d", win->rect.x, win->rect.y); mu_label(ctx, buf);
      mu_label(ctx, "Size:");
      sprintf(buf, "%d, %d", win->rect.w, win->rect.h); mu_label(ctx, buf);
    }

    /* labels + buttons */
    if (mu_header_ex(ctx, "Test Buttons", MU_OPT_EXPANDED)) {
      mu_layout_row(ctx, 3, (int[]) { 86, -110, -1 }, 0);
      mu_label(ctx, "Test buttons 1:");
      if (mu_button(ctx, "Button 1")) { write_log("Pressed button 1"); }
      if (mu_button(ctx, "Button 2")) { write_log("Pressed button 2"); }
      mu_label(ctx, "Test buttons 2:");
      if (mu_button(ctx, "Button 3")) { write_log("Pressed button 3"); }
      if (mu_button(ctx, "Popup")) { mu_open_popup(ctx, "Test Popup"); }
      if (mu_begin_popup(ctx, "Test Popup")) {
        mu_button(ctx, "Hello");
        mu_button(ctx, "World");
        mu_end_popup(ctx);
      }
    }

    /* tree */
    if (mu_header_ex(ctx, "Tree and Text", MU_OPT_EXPANDED)) {
      mu_layout_row(ctx, 2, (int[]) { 140, -1 }, 0);
      mu_layout_begin_column(ctx);
      if (mu_begin_treenode(ctx, "Test 1")) {
        if (mu_begin_treenode(ctx, "Test 1a")) {
          mu_label(ctx, "Hello");
          mu_label(ctx, "world");
          mu_end_treenode(ctx);
        }
        if (mu_begin_treenode(ctx, "Test 1b")) {
          if (mu_button(ctx, "Button 1")) { write_log("Pressed button 1"); }
          if (mu_button(ctx, "Button 2")) { write_log("Pressed button 2"); }
          mu_end_treenode(ctx);
        }
        mu_end_treenode(ctx);
      }
      if (mu_begin_treenode(ctx, "Test 2")) {
        mu_layout_row(ctx, 2, (int[]) { 54, 54 }, 0);
        if (mu_button(ctx, "Button 3")) { write_log("Pressed button 3"); }
        if (mu_button(ctx, "Button 4")) { write_log("Pressed button 4"); }
        if (mu_button(ctx, "Button 5")) { write_log("Pressed button 5"); }
        if (mu_button(ctx, "Button 6")) { write_log("Pressed button 6"); }
        mu_end_treenode(ctx);
      }
      if (mu_begin_treenode(ctx, "Test 3")) {
        static int checks[3] = { 1, 0, 1 };
        mu_checkbox(ctx, "Checkbox 1", &checks[0]);
        mu_checkbox(ctx, "Checkbox 2", &checks[1]);
        mu_checkbox(ctx, "Checkbox 3", &checks[2]);
        mu_end_treenode(ctx);
      }
      mu_layout_end_column(ctx);

      mu_layout_begin_column(ctx);
      mu_layout_row(ctx, 1, (int[]) { -1 }, 0);
      mu_text(ctx, "Lorem ipsum dolor sit amet, consectetur adipiscing "
        "elit. Maecenas lacinia, sem eu lacinia molestie, mi risus faucibus "
        "ipsum, eu varius magna felis a nulla.");
      mu_layout_end_column(ctx);
    }

    /* background color sliders */
    if (mu_header_ex(ctx, "Background Color", MU_OPT_EXPANDED)) {
      mu_layout_row(ctx, 2, (int[]) { -78, -1 }, 74);
      /* sliders */
      mu_layout_begin_column(ctx);
      mu_layout_row(ctx, 2, (int[]) { 46, -1 }, 0);
      mu_label(ctx, "Red:");   mu_slider(ctx, &bg[0], 0, 255);
      mu_label(ctx, "Green:"); mu_slider(ctx, &bg[1], 0, 255);
      mu_label(ctx, "Blue:");  mu_slider(ctx, &bg[2], 0, 255);
      mu_layout_end_column(ctx);
      /* color preview */
      mu_Rect r = mu_layout_next(ctx);
      mu_draw_rect(ctx, r, mu_color(bg[0], bg[1], bg[2], 255));
      char buf[32];
      sprintf(buf, "#%02X%02X%02X", (int) bg[0], (int) bg[1], (int) bg[2]);
      mu_draw_control_text(ctx, buf, r, MU_COLOR_TEXT, MU_OPT_ALIGNCENTER);
    }

    mu_end_window(ctx);
  }
}


static void log_window(mu_Context *ctx) {
  if (mu_begin_window(ctx, "Log Window", mu_rect(350, 40, 300, 200))) {
    /* output text panel */
    mu_layout_row(ctx, 1, (int[]) { -1 }, -25);
    mu_begin_panel(ctx, "Log Output");
    mu_Container *panel = mu_get_current_container(ctx);
    mu_layout_row(ctx, 1, (int[]) { -1 }, -1);
    mu_text(ctx, logbuf);
    mu_end_panel(ctx);
    if (logbuf_updated) {
      panel->scroll.y = panel->content_size.y;
      logbuf_updated = 0;
    }

    /* input textbox + submit button */
    static char buf[128];
    int submitted = 0;
    mu_layout_row(ctx, 2, (int[]) { -70, -1 }, 0);
    if (mu_textbox(ctx, buf, sizeof(buf)) & MU_RES_SUBMIT) {
      mu_set_focus(ctx, ctx->last_id);
      submitted = 1;
    }
    if (mu_button(ctx, "Submit")) { submitted = 1; }
    if (submitted) {
      write_log(buf);
      buf[0] = '\0';
    }

    mu_end_window(ctx);
  }
}


static int uint8_slider(mu_Context *ctx, unsigned char *value, int low, int high) {
  static float tmp;
  mu_push_id(ctx, &value, sizeof(value));
  tmp = *value;
  int res = mu_slider_ex(ctx, &tmp, low, high, 0, "%.0f", MU_OPT_ALIGNCENTER);
  *value = tmp;
  mu_pop_id(ctx);
  return res;
}


static void style_window(mu_Context *ctx) {
  static struct { const char *label; int idx; } colors[] = {
    { "text:",         MU_COLOR_TEXT        },
    { "border:",       MU_COLOR_BORDER      },
    { "windowbg:",     MU_COLOR_WINDOWBG    },
    { "titlebg:",      MU_COLOR_TITLEBG     },
    { "titletext:",    MU_COLOR_TITLETEXT   },
    { "panelbg:",      MU_COLOR_PANELBG     },
    { "button:",       MU_COLOR_BUTTON      },
    { "buttonhover:",  MU_COLOR_BUTTONHOVER },
    { "buttonfocus:",  MU_COLOR_BUTTONFOCUS },
    { "base:",         MU_COLOR_BASE        },
    { "basehover:",    MU_COLOR_BASEHOVER   },
    { "basefocus:",    MU_COLOR_BASEFOCUS   },
    { "scrollbase:",   MU_COLOR_SCROLLBASE  },
    { "scrollthumb:",  MU_COLOR_SCROLLTHUMB },
    { NULL }
  };

  if (mu_begin_window(ctx, "Style Editor", mu_rect(350, 250, 300, 240))) {
    int sw = mu_get_current_container(ctx)->body.w * 0.14;
    mu_layout_row(ctx, 6, (int[]) { 80, sw, sw, sw, sw, -1 }, 0);
    for (int i = 0; colors[i].label; i++) {
      mu_label(ctx, colors[i].label);
      uint8_slider(ctx, &ctx->style->colors[i].r, 0, 255);
      uint8_slider(ctx, &ctx->style->colors[i].g, 0, 255);
      uint8_slider(ctx, &ctx->style->colors[i].b, 0, 255);
      uint8_slider(ctx, &ctx->style->colors[i].a, 0, 255);
      mu_draw_rect(ctx, mu_layout_next(ctx), ctx->style->colors[i]);
    }
    mu_end_window(ctx);
  }
}


static void process_frame(mu_Context *ctx) {
  mu_begin(ctx);
  style_window(ctx);
  log_window(ctx);
  test_window(ctx);
  mu_end(ctx);
}




static int text_width(mu_Font font, const char *text, int len) {
  if (len == -1) { len = strlen(text); }
  return r_get_text_width(text, len);
}

static int text_height(mu_Font font) {
  return r_get_text_height();
}


int main(int argc, char **argv) {
  r_init();

  /* init microui */
  mu_Context *ctx = r_get_context();
  mu_init(ctx);
  ctx->text_width = text_width;
  ctx->text_height = text_height;

 
    while(true){
    /* process frame */
    process_frame(ctx);

    /* render */
    r_clear(mu_color(bg[0], bg[1], bg[2], 255));
    mu_Command *cmd = NULL;
    while (mu_next_command(ctx, &cmd)) {
      switch (cmd->type) {
        case MU_COMMAND_TEXT: r_draw_text(cmd->text.str, cmd->text.pos, cmd->text.color); break;
        case MU_COMMAND_RECT: r_draw_rect(cmd->rect.rect, cmd->rect.color); break;
        case MU_COMMAND_ICON: r_draw_icon(cmd->icon.id, cmd->icon.rect, cmd->icon.color); break;
        case MU_COMMAND_CLIP: r_set_clip_rect(cmd->clip.rect); break;
      }
    }
    r_present();
  
    k_sleep(K_MSEC(10)); // Sleep for 16 ms to simulate ~60 FPS
}
  return 0;
}
```

## src/font_generated.h
```c
/*
 * Variable Width Bitmap Font Data
 * Generated from: Montserrat-Medium.ttf
 * Font size: 12 pixels
 * Bitmap size: 16x14 pixels
 * Average character width: 7.1 pixels
 * Character range: ASCII 32-127 (96 characters)
 * Format: Variable width, 1 bit per pixel
 */

#ifndef FONT_MONTSERRAT_12_H
#define FONT_MONTSERRAT_12_H

#include <stdint.h>

#define FONT_HEIGHT 14
#define FONT_BITMAP_WIDTH 16
#define FONT_BYTES_PER_ROW 2
#define FONT_FIRST_CHAR 32
#define FONT_LAST_CHAR 127
#define FONT_CHAR_COUNT 96
#define FONT_DEFAULT_WIDTH 7
#define FONT_CHAR_SPACING 1

typedef struct {
    uint32_t unicode;
    uint8_t width;        // Actual character width
    uint8_t bitmap[28];  // Bitmap data (2 bytes per row)
} FontGlyph;

static const FontGlyph font_data[] = {
    { 32,  4, {
        0x00, 0x00, 0x00, 0x00, 0x00, 0x00, 0x00, 0x00,
        0x00, 0x00, 0x00, 0x00, 0x00, 0x00, 0x00, 0x00,
        0x00, 0x00, 0x00, 0x00, 0x00, 0x00, 0x00, 0x00,
        0x00, 0x00, 0x00, 0x00
    }}, // Space (width: 4)
    { 33,  3, {
        0x00, 0x00, 0x00, 0x00, 0x00, 0x00, 0x40, 0x00,
        0x40, 0x00, 0x40, 0x00, 0x40, 0x00, 0x40, 0x00,
        0x40, 0x00, 0x00, 0x00, 0x00, 0x00, 0x40, 0x00,
        0x00, 0x00, 0x00, 0x00
    }}, // '!' (width: 3)
    { 34,  5, {
        0x00, 0x00, 0x00, 0x00, 0x00, 0x00, 0x50, 0x00,
        0x50, 0x00, 0x50, 0x00, 0x00, 0x00, 0x00, 0x00,
        0x00, 0x00, 0x00, 0x00, 0x00, 0x00, 0x00, 0x00,
        0x00, 0x00, 0x00, 0x00
    }}, // '"' (width: 5)
    { 35,  9, {
        0x00, 0x00, 0x00, 0x00, 0x00, 0x00, 0x12, 0x00,
        0x22, 0x00, 0x7F, 0x00, 0x24, 0x00, 0x24, 0x00,
        0x24, 0x00, 0xFF, 0x00, 0x24, 0x00, 0x24, 0x00,
        0x00, 0x00, 0x00, 0x00
    }}, // '#' (width: 9)
    { 36,  7, {
        0x00, 0x00, 0x10, 0x00, 0x10, 0x00, 0x3C, 0x00,
        0x52, 0x00, 0x50, 0x00, 0x70, 0x00, 0x3C, 0x00,
        0x16, 0x00, 0x12, 0x00, 0xD6, 0x00, 0x7C, 0x00,
        0x10, 0x00, 0x00, 0x00
    }}, // '$' (width: 7)
    { 37, 10, {
        0x00, 0x00, 0x00, 0x00, 0x00, 0x00, 0x71, 0x00,
        0x52, 0x00, 0x92, 0x00, 0x94, 0x00, 0x75, 0x80,
        0x0A, 0x40, 0x12, 0x40, 0x12, 0x40, 0x23, 0x80,
        0x00, 0x00, 0x00, 0x00
    }}, // '%' (width: 10)
    { 38,  9, {
        0x00, 0x00, 0x00, 0x00, 0x00, 0x00, 0x38, 0x00,
        0x24, 0x00, 0x24, 0x00, 0x28, 0x00, 0x30, 0x00,
        0x49, 0x00, 0x46, 0x00, 0x46, 0x00, 0x39, 0x00,
        0x00, 0x00, 0x00, 0x00
    }}, // '&' (width: 9)
    { 39,  3, {
        0x00, 0x00, 0x00, 0x00, 0x00, 0x00, 0x40, 0x00,
        0x40, 0x00, 0x40, 0x00, 0x00, 0x00, 0x00, 0x00,
        0x00, 0x00, 0x00, 0x00, 0x00, 0x00, 0x00, 0x00,
        0x00, 0x00, 0x00, 0x00
    }}, // "'" (width: 3)
    { 40,  4, {
        0x00, 0x00, 0x00, 0x00, 0x30, 0x00, 0x20, 0x00,
        0x20, 0x00, 0x60, 0x00, 0x40, 0x00, 0x40, 0x00,
        0x40, 0x00, 0x40, 0x00, 0x40, 0x00, 0x60, 0x00,
        0x20, 0x00, 0x20, 0x00
    }}, // '(' (width: 4)
    { 41,  4, {
        0x00, 0x00, 0x00, 0x00, 0xC0, 0x00, 0x40, 0x00,
        0x40, 0x00, 0x20, 0x00, 0x20, 0x00, 0x20, 0x00,
        0x20, 0x00, 0x20, 0x00, 0x20, 0x00, 0x20, 0x00,
        0x40, 0x00, 0x40, 0x00
    }}, // ')' (width: 4)
    { 42,  5, {
        0x00, 0x00, 0x00, 0x00, 0x20, 0x00, 0xF8, 0x00,
        0x20, 0x00, 0xF8, 0x00, 0x20, 0x00, 0x00, 0x00,
        0x00, 0x00, 0x00, 0x00, 0x00, 0x00, 0x00, 0x00,
        0x00, 0x00, 0x00, 0x00
    }}, // '*' (width: 5)
    { 43,  7, {
        0x00, 0x00, 0x00, 0x00, 0x00, 0x00, 0x00, 0x00,
        0x10, 0x00, 0x10, 0x00, 0x10, 0x00, 0x7C, 0x00,
        0x10, 0x00, 0x10, 0x00, 0x00, 0x00, 0x00, 0x00,
        0x00, 0x00, 0x00, 0x00
    }}, // '+' (width: 7)
    { 44,  3, {
        0x00, 0x00, 0x00, 0x00, 0x00, 0x00, 0x00, 0x00,
        0x00, 0x00, 0x00, 0x00, 0x00, 0x00, 0x00, 0x00,
        0x00, 0x00, 0x00, 0x00, 0x40, 0x00, 0x40, 0x00,
        0x40, 0x00, 0x40, 0x00
    }}, // ',' (width: 3)
    { 45,  5, {
        0x00, 0x00, 0x00, 0x00, 0x00, 0x00, 0x00, 0x00,
        0x00, 0x00, 0x00, 0x00, 0x00, 0x00, 0x00, 0x00,
        0x70, 0x00, 0x00, 0x00, 0x00, 0x00, 0x00, 0x00,
        0x00, 0x00, 0x00, 0x00
    }}, // '-' (width: 5)
    { 46,  3, {
        0x00, 0x00, 0x00, 0x00, 0x00, 0x00, 0x00, 0x00,
        0x00, 0x00, 0x00, 0x00, 0x00, 0x00, 0x00, 0x00,
        0x00, 0x00, 0x00, 0x00, 0x40, 0x00, 0x40, 0x00,
        0x00, 0x00, 0x00, 0x00
    }}, // '.' (width: 3)
    { 47,  6, {
        0x10, 0x00, 0x20, 0x00, 0x20, 0x00, 0x20, 0x00,
        0x40, 0x00, 0x40, 0x00, 0x40, 0x00, 0x80, 0x00,
        0x80, 0x00, 0x80, 0x00, 0x00, 0x00, 0x00, 0x00,
        0x00, 0x00, 0x00, 0x00
    }}, // '/' (width: 6)
    { 48,  8, {
        0x00, 0x00, 0x00, 0x00, 0x00, 0x00, 0x3C, 0x00,
        0x66, 0x00, 0x42, 0x00, 0x42, 0x00, 0x42, 0x00,
        0x42, 0x00, 0x42, 0x00, 0x66, 0x00, 0x3C, 0x00,
        0x00, 0x00, 0x00, 0x00
    }}, // '0' (width: 8)
    { 49,  4, {
        0x00, 0x00, 0x00, 0x00, 0x00, 0x00, 0xE0, 0x00,
        0x20, 0x00, 0x20, 0x00, 0x20, 0x00, 0x20, 0x00,
        0x20, 0x00, 0x20, 0x00, 0x20, 0x00, 0x20, 0x00,
        0x00, 0x00, 0x00, 0x00
    }}, // '1' (width: 4)
    { 50,  7, {
        0x00, 0x00, 0x00, 0x00, 0x00, 0x00, 0x78, 0x00,
        0xCC, 0x00, 0x04, 0x00, 0x04, 0x00, 0x08, 0x00,
        0x18, 0x00, 0x30, 0x00, 0x60, 0x00, 0xFC, 0x00,
        0x00, 0x00, 0x00, 0x00
    }}, // '2' (width: 7)
    { 51,  7, {
        0x00, 0x00, 0x00, 0x00, 0x00, 0x00, 0xFC, 0x00,
        0x08, 0x00, 0x18, 0x00, 0x10, 0x00, 0x3C, 0x00,
        0x04, 0x00, 0x04, 0x00, 0x84, 0x00, 0x78, 0x00,
        0x00, 0x00, 0x00, 0x00
    }}, // '3' (width: 7)
    { 52,  8, {
        0x00, 0x00, 0x00, 0x00, 0x00, 0x00, 0x0C, 0x00,
        0x08, 0x00, 0x10, 0x00, 0x30, 0x00, 0x24, 0x00,
        0x44, 0x00, 0xFF, 0x00, 0x04, 0x00, 0x04, 0x00,
        0x00, 0x00, 0x00, 0x00
    }}, // '4' (width: 8)
    { 53,  7, {
        0x00, 0x00, 0x00, 0x00, 0x00, 0x00, 0x7C, 0x00,
        0x40, 0x00, 0x40, 0x00, 0x78, 0x00, 0x04, 0x00,
        0x04, 0x00, 0x04, 0x00, 0xC4, 0x00, 0x78, 0x00,
        0x00, 0x00, 0x00, 0x00
    }}, // '5' (width: 7)
    { 54,  8, {
        0x00, 0x00, 0x00, 0x00, 0x00, 0x00, 0x1E, 0x00,
        0x60, 0x00, 0x40, 0x00, 0x5C, 0x00, 0x66, 0x00,
        0x42, 0x00, 0x42, 0x00, 0x66, 0x00, 0x3C, 0x00,
        0x00, 0x00, 0x00, 0x00
    }}, // '6' (width: 8)
    { 55,  7, {
        0x00, 0x00, 0x00, 0x00, 0x00, 0x00, 0xFE, 0x00,
        0xC4, 0x00, 0xC4, 0x00, 0x0C, 0x00, 0x08, 0x00,
        0x08, 0x00, 0x10, 0x00, 0x10, 0x00, 0x30, 0x00,
        0x00, 0x00, 0x00, 0x00
    }}, // '7' (width: 7)
    { 56,  8, {
        0x00, 0x00, 0x00, 0x00, 0x00, 0x00, 0x3C, 0x00,
        0x46, 0x00, 0x42, 0x00, 0x46, 0x00, 0x3C, 0x00,
        0x46, 0x00, 0x42, 0x00, 0x46, 0x00, 0x3C, 0x00,
        0x00, 0x00, 0x00, 0x00
    }}, // '8' (width: 8)
    { 57,  7, {
        0x00, 0x00, 0x00, 0x00, 0x00, 0x00, 0x78, 0x00,
        0x44, 0x00, 0xC6, 0x00, 0xC6, 0x00, 0x7A, 0x00,
        0x02, 0x00, 0x04, 0x00, 0x4C, 0x00, 0x78, 0x00,
        0x00, 0x00, 0x00, 0x00
    }}, // '9' (width: 7)
    { 58,  3, {
        0x00, 0x00, 0x00, 0x00, 0x00, 0x00, 0x00, 0x00,
        0x00, 0x00, 0x40, 0x00, 0x40, 0x00, 0x00, 0x00,
        0x00, 0x00, 0x00, 0x00, 0x40, 0x00, 0x40, 0x00,
        0x00, 0x00, 0x00, 0x00
    }}, // ':' (width: 3)
    { 59,  3, {
        0x00, 0x00, 0x00, 0x00, 0x00, 0x00, 0x00, 0x00,
        0x00, 0x00, 0x40, 0x00, 0x40, 0x00, 0x00, 0x00,
        0x00, 0x00, 0x00, 0x00, 0x40, 0x00, 0x40, 0x00,
        0x40, 0x00, 0x40, 0x00
    }}, // ';' (width: 3)
    { 60,  7, {
        0x00, 0x00, 0x00, 0x00, 0x00, 0x00, 0x00, 0x00,
        0x00, 0x00, 0x04, 0x00, 0x18, 0x00, 0x60, 0x00,
        0x70, 0x00, 0x0C, 0x00, 0x00, 0x00, 0x00, 0x00,
        0x00, 0x00, 0x00, 0x00
    }}, // '<' (width: 7)
    { 61,  7, {
        0x00, 0x00, 0x00, 0x00, 0x00, 0x00, 0x00, 0x00,
        0x00, 0x00, 0x7C, 0x00, 0x00, 0x00, 0x00, 0x00,
        0x7C, 0x00, 0x00, 0x00, 0x00, 0x00, 0x00, 0x00,
        0x00, 0x00, 0x00, 0x00
    }}, // '=' (width: 7)
    { 62,  7, {
        0x00, 0x00, 0x00, 0x00, 0x00, 0x00, 0x00, 0x00,
        0x00, 0x00, 0x40, 0x00, 0x30, 0x00, 0x0C, 0x00,
        0x1C, 0x00, 0x60, 0x00, 0x00, 0x00, 0x00, 0x00,
        0x00, 0x00, 0x00, 0x00
    }}, // '>' (width: 7)
    { 63,  7, {
        0x00, 0x00, 0x00, 0x00, 0x00, 0x00, 0x78, 0x00,
        0xCC, 0x00, 0x04, 0x00, 0x04, 0x00, 0x08, 0x00,
        0x10, 0x00, 0x10, 0x00, 0x00, 0x00, 0x10, 0x00,
        0x00, 0x00, 0x00, 0x00
    }}, // '?' (width: 7)
    { 64, 12, {
        0x00, 0x00, 0x00, 0x00, 0x00, 0x00, 0x0F, 0x80,
        0x30, 0xC0, 0x2F, 0xA0, 0x49, 0x90, 0x50, 0x90,
        0x50, 0x90, 0x50, 0x90, 0x49, 0x90, 0x4F, 0x60,
        0x20, 0x00, 0x30, 0x80
    }}, // '@' (width: 12)
    { 65, 10, {
        0x00, 0x00, 0x00, 0x00, 0x00, 0x00, 0x10, 0x00,
        0x38, 0x00, 0x28, 0x00, 0x68, 0x00, 0x44, 0x00,
        0xC4, 0x00, 0xFE, 0x00, 0x82, 0x00, 0x03, 0x00,
        0x00, 0x00, 0x00, 0x00
    }}, // 'A' (width: 10)
    { 66,  9, {
        0x00, 0x00, 0x00, 0x00, 0x00, 0x00, 0x7E, 0x00,
        0x43, 0x00, 0x41, 0x00, 0x41, 0x00, 0x7E, 0x00,
        0x41, 0x00, 0x41, 0x00, 0x41, 0x00, 0x7F, 0x00,
        0x00, 0x00, 0x00, 0x00
    }}, // 'B' (width: 9)
    { 67,  9, {
        0x00, 0x00, 0x00, 0x00, 0x00, 0x00, 0x1E, 0x00,
        0x21, 0x00, 0x40, 0x00, 0x40, 0x00, 0x40, 0x00,
        0x40, 0x00, 0x40, 0x00, 0x21, 0x00, 0x1E, 0x00,
        0x00, 0x00, 0x00, 0x00
    }}, // 'C' (width: 9)
    { 68, 10, {
        0x00, 0x00, 0x00, 0x00, 0x00, 0x00, 0x7E, 0x00,
        0x41, 0x00, 0x40, 0x80, 0x40, 0x80, 0x40, 0x80,
        0x40, 0x80, 0x40, 0x80, 0x41, 0x00, 0x7E, 0x00,
        0x00, 0x00, 0x00, 0x00
    }}, // 'D' (width: 10)
    { 69,  8, {
        0x00, 0x00, 0x00, 0x00, 0x00, 0x00, 0x7E, 0x00,
        0x40, 0x00, 0x40, 0x00, 0x40, 0x00, 0x7E, 0x00,
        0x40, 0x00, 0x40, 0x00, 0x40, 0x00, 0x7E, 0x00,
        0x00, 0x00, 0x00, 0x00
    }}, // 'E' (width: 8)
    { 70,  8, {
        0x00, 0x00, 0x00, 0x00, 0x00, 0x00, 0x7E, 0x00,
        0x40, 0x00, 0x40, 0x00, 0x40, 0x00, 0x7E, 0x00,
        0x40, 0x00, 0x40, 0x00, 0x40, 0x00, 0x40, 0x00,
        0x00, 0x00, 0x00, 0x00
    }}, // 'F' (width: 8)
    { 71,  9, {
        0x00, 0x00, 0x00, 0x00, 0x00, 0x00, 0x1E, 0x00,
        0x21, 0x00, 0x40, 0x00, 0x40, 0x00, 0x41, 0x00,
        0x41, 0x00, 0x41, 0x00, 0x21, 0x00, 0x1E, 0x00,
        0x00, 0x00, 0x00, 0x00
    }}, // 'G' (width: 9)
    { 72, 10, {
        0x00, 0x00, 0x00, 0x00, 0x00, 0x00, 0x41, 0x00,
        0x41, 0x00, 0x41, 0x00, 0x41, 0x00, 0x7F, 0x00,
        0x41, 0x00, 0x41, 0x00, 0x41, 0x00, 0x41, 0x00,
        0x00, 0x00, 0x00, 0x00
    }}, // 'H' (width: 10)
    { 73,  4, {
        0x00, 0x00, 0x00, 0x00, 0x00, 0x00, 0x40, 0x00,
        0x40, 0x00, 0x40, 0x00, 0x40, 0x00, 0x40, 0x00,
        0x40, 0x00, 0x40, 0x00, 0x40, 0x00, 0x40, 0x00,
        0x00, 0x00, 0x00, 0x00
    }}, // 'I' (width: 4)
    { 74,  7, {
        0x00, 0x00, 0x00, 0x00, 0x00, 0x00, 0xF0, 0x00,
        0x10, 0x00, 0x10, 0x00, 0x10, 0x00, 0x10, 0x00,
        0x10, 0x00, 0x10, 0x00, 0x30, 0x00, 0xE0, 0x00,
        0x00, 0x00, 0x00, 0x00
    }}, // 'J' (width: 7)
    { 75,  9, {
        0x00, 0x00, 0x00, 0x00, 0x00, 0x00, 0x41, 0x00,
        0x42, 0x00, 0x44, 0x00, 0x48, 0x00, 0x58, 0x00,
        0x7C, 0x00, 0x66, 0x00, 0x42, 0x00, 0x41, 0x80,
        0x00, 0x00, 0x00, 0x00
    }}, // 'K' (width: 9)
    { 76,  8, {
        0x00, 0x00, 0x00, 0x00, 0x00, 0x00, 0x40, 0x00,
        0x40, 0x00, 0x40, 0x00, 0x40, 0x00, 0x40, 0x00,
        0x40, 0x00, 0x40, 0x00, 0x40, 0x00, 0x7E, 0x00,
        0x00, 0x00, 0x00, 0x00
    }}, // 'L' (width: 8)
    { 77, 11, {
        0x00, 0x00, 0x00, 0x00, 0x00, 0x00, 0x60, 0x40,
        0x60, 0xC0, 0x70, 0xC0, 0x51, 0x40, 0x49, 0x40,
        0x4A, 0x40, 0x46, 0x40, 0x44, 0x40, 0x40, 0x40,
        0x00, 0x00, 0x00, 0x00
    }}, // 'M' (width: 11)
    { 78, 10, {
        0x00, 0x00, 0x00, 0x00, 0x00, 0x00, 0x61, 0x00,
        0x61, 0x00, 0x51, 0x00, 0x59, 0x00, 0x4D, 0x00,
        0x45, 0x00, 0x43, 0x00, 0x43, 0x00, 0x41, 0x00,
        0x00, 0x00, 0x00, 0x00
    }}, // 'N' (width: 10)
    { 79, 10, {
        0x00, 0x00, 0x00, 0x00, 0x00, 0x00, 0x1E, 0x00,
        0x21, 0x00, 0x40, 0x80, 0x40, 0x80, 0x40, 0xC0,
        0x40, 0x80, 0x40, 0x80, 0x21, 0x00, 0x1E, 0x00,
        0x00, 0x00, 0x00, 0x00
    }}, // 'O' (width: 10)
    { 80,  9, {
        0x00, 0x00, 0x00, 0x00, 0x00, 0x00, 0x7E, 0x00,
        0x43, 0x00, 0x41, 0x00, 0x41, 0x00, 0x43, 0x00,
        0x7E, 0x00, 0x40, 0x00, 0x40, 0x00, 0x40, 0x00,
        0x00, 0x00, 0x00, 0x00
    }}, // 'P' (width: 9)
    { 81, 10, {
        0x00, 0x00, 0x00, 0x00, 0x00, 0x00, 0x1E, 0x00,
        0x21, 0x00, 0x40, 0x80, 0x40, 0x80, 0x40, 0xC0,
        0x40, 0x80, 0x40, 0x80, 0x21, 0x00, 0x1E, 0x00,
        0x06, 0x40, 0x03, 0x80
    }}, // 'Q' (width: 10)
    { 82,  9, {
        0x00, 0x00, 0x00, 0x00, 0x00, 0x00, 0x7E, 0x00,
        0x43, 0x00, 0x41, 0x00, 0x41, 0x00, 0x43, 0x00,
        0x7E, 0x00, 0x46, 0x00, 0x42, 0x00, 0x41, 0x00,
        0x00, 0x00, 0x00, 0x00
    }}, // 'R' (width: 9)
    { 83,  7, {
        0x00, 0x00, 0x00, 0x00, 0x00, 0x00, 0x3C, 0x00,
        0x42, 0x00, 0x40, 0x00, 0x60, 0x00, 0x3C, 0x00,
        0x06, 0x00, 0x02, 0x00, 0xC6, 0x00, 0x7C, 0x00,
        0x00, 0x00, 0x00, 0x00
    }}, // 'S' (width: 7)
    { 84,  7, {
        0x00, 0x00, 0x00, 0x00, 0x00, 0x00, 0xFE, 0x00,
        0x10, 0x00, 0x10, 0x00, 0x10, 0x00, 0x10, 0x00,
        0x10, 0x00, 0x10, 0x00, 0x10, 0x00, 0x10, 0x00,
        0x00, 0x00, 0x00, 0x00
    }}, // 'T' (width: 7)
    { 85,  9, {
        0x00, 0x00, 0x00, 0x00, 0x00, 0x00, 0x41, 0x00,
        0x41, 0x00, 0x41, 0x00, 0x41, 0x00, 0x41, 0x00,
        0x41, 0x00, 0x61, 0x00, 0x23, 0x00, 0x1E, 0x00,
        0x00, 0x00, 0x00, 0x00
    }}, // 'U' (width: 9)
    { 86, 10, {
        0x00, 0x00, 0x00, 0x00, 0x00, 0x00, 0x03, 0x00,
        0x82, 0x00, 0x86, 0x00, 0xC4, 0x00, 0x44, 0x00,
        0x68, 0x00, 0x28, 0x00, 0x30, 0x00, 0x30, 0x00,
        0x00, 0x00, 0x00, 0x00
    }}, // 'V' (width: 10)
    { 87, 14, {
        0x00, 0x00, 0x00, 0x00, 0x00, 0x00, 0xC3, 0x08,
        0x43, 0x08, 0x47, 0x10, 0x65, 0x10, 0x24, 0x90,
        0x2C, 0xA0, 0x38, 0xA0, 0x18, 0x60, 0x18, 0x40,
        0x00, 0x00, 0x00, 0x00
    }}, // 'W' (width: 14)
    { 88,  8, {
        0x00, 0x00, 0x00, 0x00, 0x00, 0x00, 0xC3, 0x00,
        0x66, 0x00, 0x24, 0x00, 0x18, 0x00, 0x18, 0x00,
        0x18, 0x00, 0x24, 0x00, 0x62, 0x00, 0xC3, 0x00,
        0x00, 0x00, 0x00, 0x00
    }}, // 'X' (width: 8)
    { 89,  9, {
        0x00, 0x00, 0x00, 0x00, 0x00, 0x00, 0x86, 0x00,
        0x84, 0x00, 0xC8, 0x00, 0x48, 0x00, 0x70, 0x00,
        0x30, 0x00, 0x20, 0x00, 0x20, 0x00, 0x20, 0x00,
        0x00, 0x00, 0x00, 0x00
    }}, // 'Y' (width: 9)
    { 90,  8, {
        0x00, 0x00, 0x00, 0x00, 0x00, 0x00, 0x7E, 0x00,
        0x06, 0x00, 0x04, 0x00, 0x08, 0x00, 0x18, 0x00,
        0x10, 0x00, 0x20, 0x00, 0x40, 0x00, 0x7F, 0x00,
        0x00, 0x00, 0x00, 0x00
    }}, // 'Z' (width: 8)
    { 91,  4, {
        0x00, 0x00, 0x00, 0x00, 0x70, 0x00, 0x40, 0x00,
        0x40, 0x00, 0x40, 0x00, 0x40, 0x00, 0x40, 0x00,
        0x40, 0x00, 0x40, 0x00, 0x40, 0x00, 0x40, 0x00,
        0x40, 0x00, 0x40, 0x00
    }}, // '[' (width: 4)
    { 92,  6, {
        0x00, 0x00, 0x00, 0x00, 0x00, 0x00, 0x80, 0x00,
        0x80, 0x00, 0x80, 0x00, 0x80, 0x00, 0x40, 0x00,
        0x40, 0x00, 0x40, 0x00, 0x20, 0x00, 0x20, 0x00,
        0x30, 0x00, 0x00, 0x00
    }}, // '\\' (width: 6)
    { 93,  4, {
        0x00, 0x00, 0x00, 0x00, 0xE0, 0x00, 0x20, 0x00,
        0x20, 0x00, 0x20, 0x00, 0x20, 0x00, 0x20, 0x00,
        0x20, 0x00, 0x20, 0x00, 0x20, 0x00, 0x20, 0x00,
        0x20, 0x00, 0x20, 0x00
    }}, // ']' (width: 4)
    { 94,  7, {
        0x00, 0x00, 0x00, 0x00, 0x00, 0x00, 0x00, 0x00,
        0x10, 0x00, 0x10, 0x00, 0x28, 0x00, 0x28, 0x00,
        0x44, 0x00, 0x44, 0x00, 0x00, 0x00, 0x00, 0x00,
        0x00, 0x00, 0x00, 0x00
    }}, // '^' (width: 7)
    { 95,  6, {
        0x00, 0x00, 0x00, 0x00, 0x00, 0x00, 0x00, 0x00,
        0x00, 0x00, 0x00, 0x00, 0x00, 0x00, 0x00, 0x00,
        0x00, 0x00, 0x00, 0x00, 0x00, 0x00, 0x00, 0x00,
        0xFC, 0x00, 0x00, 0x00
    }}, // '_' (width: 6)
    { 96,  7, {
        0x00, 0x00, 0x00, 0x00, 0x60, 0x00, 0x18, 0x00,
        0x00, 0x00, 0x00, 0x00, 0x00, 0x00, 0x00, 0x00,
        0x00, 0x00, 0x00, 0x00, 0x00, 0x00, 0x00, 0x00,
        0x00, 0x00, 0x00, 0x00
    }}, // '`' (width: 7)
    { 97,  7, {
        0x00, 0x00, 0x00, 0x00, 0x00, 0x00, 0x00, 0x00,
        0x00, 0x00, 0x78, 0x00, 0x44, 0x00, 0x04, 0x00,
        0x7C, 0x00, 0x44, 0x00, 0x44, 0x00, 0x7C, 0x00,
        0x00, 0x00, 0x00, 0x00
    }}, // 'a' (width: 7)
    { 98,  8, {
        0x00, 0x00, 0x00, 0x00, 0x40, 0x00, 0x40, 0x00,
        0x40, 0x00, 0x5C, 0x00, 0x62, 0x00, 0x43, 0x00,
        0x41, 0x00, 0x43, 0x00, 0x62, 0x00, 0x5C, 0x00,
        0x00, 0x00, 0x00, 0x00
    }}, // 'b' (width: 8)
    { 99,  7, {
        0x00, 0x00, 0x00, 0x00, 0x00, 0x00, 0x00, 0x00,
        0x00, 0x00, 0x3C, 0x00, 0x64, 0x00, 0x40, 0x00,
        0xC0, 0x00, 0x40, 0x00, 0x64, 0x00, 0x3C, 0x00,
        0x00, 0x00, 0x00, 0x00
    }}, // 'c' (width: 7)
    {100,  8, {
        0x00, 0x00, 0x00, 0x00, 0x02, 0x00, 0x02, 0x00,
        0x02, 0x00, 0x3A, 0x00, 0x66, 0x00, 0x42, 0x00,
        0xC2, 0x00, 0x42, 0x00, 0x66, 0x00, 0x3A, 0x00,
        0x00, 0x00, 0x00, 0x00
    }}, // 'd' (width: 8)
    {101,  7, {
        0x00, 0x00, 0x00, 0x00, 0x00, 0x00, 0x00, 0x00,
        0x00, 0x00, 0x38, 0x00, 0x44, 0x00, 0x42, 0x00,
        0xFE, 0x00, 0x40, 0x00, 0x44, 0x00, 0x3C, 0x00,
        0x00, 0x00, 0x00, 0x00
    }}, // 'e' (width: 7)
    {102,  5, {
        0x00, 0x00, 0x00, 0x00, 0x38, 0x00, 0x60, 0x00,
        0x40, 0x00, 0xF0, 0x00, 0x40, 0x00, 0x40, 0x00,
        0x40, 0x00, 0x40, 0x00, 0x40, 0x00, 0x40, 0x00,
        0x00, 0x00, 0x00, 0x00
    }}, // 'f' (width: 5)
    {103,  8, {
        0x00, 0x00, 0x00, 0x00, 0x00, 0x00, 0x00, 0x00,
        0x00, 0x00, 0x3A, 0x00, 0x66, 0x00, 0x42, 0x00,
        0xC2, 0x00, 0x42, 0x00, 0x66, 0x00, 0x3A, 0x00,
        0x02, 0x00, 0x46, 0x00
    }}, // 'g' (width: 8)
    {104,  8, {
        0x00, 0x00, 0x00, 0x00, 0x40, 0x00, 0x40, 0x00,
        0x40, 0x00, 0x5C, 0x00, 0x66, 0x00, 0x42, 0x00,
        0x42, 0x00, 0x42, 0x00, 0x42, 0x00, 0x42, 0x00,
        0x00, 0x00, 0x00, 0x00
    }}, // 'h' (width: 8)
    {105,  3, {
        0x00, 0x00, 0x00, 0x00, 0x40, 0x00, 0x00, 0x00,
        0x00, 0x00, 0x40, 0x00, 0x40, 0x00, 0x40, 0x00,
        0x40, 0x00, 0x40, 0x00, 0x40, 0x00, 0x40, 0x00,
        0x00, 0x00, 0x00, 0x00
    }}, // 'i' (width: 3)
    {106,  5, {
        0x00, 0x00, 0x00, 0x00, 0xC0, 0x00, 0x00, 0x00,
        0x00, 0x00, 0x80, 0x00, 0x80, 0x00, 0x80, 0x00,
        0x80, 0x00, 0x80, 0x00, 0x80, 0x00, 0x80, 0x00,
        0x80, 0x00, 0x80, 0x00
    }}, // 'j' (width: 5)
    {107,  8, {
        0x00, 0x00, 0x00, 0x00, 0x40, 0x00, 0x40, 0x00,
        0x40, 0x00, 0x46, 0x00, 0x4C, 0x00, 0x58, 0x00,
        0x78, 0x00, 0x6C, 0x00, 0x44, 0x00, 0x42, 0x00,
        0x00, 0x00, 0x00, 0x00
    }}, // 'k' (width: 8)
    {108,  3, {
        0x00, 0x00, 0x00, 0x00, 0x40, 0x00, 0x40, 0x00,
        0x40, 0x00, 0x40, 0x00, 0x40, 0x00, 0x40, 0x00,
        0x40, 0x00, 0x40, 0x00, 0x40, 0x00, 0x40, 0x00,
        0x00, 0x00, 0x00, 0x00
    }}, // 'l' (width: 3)
    {109, 13, {
        0x00, 0x00, 0x00, 0x00, 0x00, 0x00, 0x00, 0x00,
        0x00, 0x00, 0x5D, 0xE0, 0x67, 0x20, 0x42, 0x30,
        0x42, 0x30, 0x42, 0x30, 0x42, 0x30, 0x42, 0x30,
        0x00, 0x00, 0x00, 0x00
    }}, // 'm' (width: 13)
    {110,  8, {
        0x00, 0x00, 0x00, 0x00, 0x00, 0x00, 0x00, 0x00,
        0x00, 0x00, 0x5C, 0x00, 0x66, 0x00, 0x42, 0x00,
        0x42, 0x00, 0x42, 0x00, 0x42, 0x00, 0x42, 0x00,
        0x00, 0x00, 0x00, 0x00
    }}, // 'n' (width: 8)
    {111,  8, {
        0x00, 0x00, 0x00, 0x00, 0x00, 0x00, 0x00, 0x00,
        0x00, 0x00, 0x3C, 0x00, 0x66, 0x00, 0x42, 0x00,
        0xC2, 0x00, 0x42, 0x00, 0x66, 0x00, 0x3C, 0x00,
        0x00, 0x00, 0x00, 0x00
    }}, // 'o' (width: 8)
    {112,  8, {
        0x00, 0x00, 0x00, 0x00, 0x00, 0x00, 0x00, 0x00,
        0x00, 0x00, 0x5C, 0x00, 0x62, 0x00, 0x43, 0x00,
        0x41, 0x00, 0x43, 0x00, 0x62, 0x00, 0x5C, 0x00,
        0x40, 0x00, 0x40, 0x00
    }}, // 'p' (width: 8)
    {113,  8, {
        0x00, 0x00, 0x00, 0x00, 0x00, 0x00, 0x00, 0x00,
        0x00, 0x00, 0x3A, 0x00, 0x66, 0x00, 0x42, 0x00,
        0xC2, 0x00, 0x42, 0x00, 0x66, 0x00, 0x3A, 0x00,
        0x02, 0x00, 0x02, 0x00
    }}, // 'q' (width: 8)
    {114,  5, {
        0x00, 0x00, 0x00, 0x00, 0x00, 0x00, 0x00, 0x00,
        0x00, 0x00, 0x58, 0x00, 0x60, 0x00, 0x40, 0x00,
        0x40, 0x00, 0x40, 0x00, 0x40, 0x00, 0x40, 0x00,
        0x00, 0x00, 0x00, 0x00
    }}, // 'r' (width: 5)
    {115,  6, {
        0x00, 0x00, 0x00, 0x00, 0x00, 0x00, 0x00, 0x00,
        0x00, 0x00, 0x78, 0x00, 0x48, 0x00, 0xC0, 0x00,
        0x78, 0x00, 0x0C, 0x00, 0x8C, 0x00, 0x78, 0x00,
        0x00, 0x00, 0x00, 0x00
    }}, // 's' (width: 6)
    {116,  5, {
        0x00, 0x00, 0x00, 0x00, 0x00, 0x00, 0x40, 0x00,
        0x40, 0x00, 0xF0, 0x00, 0x40, 0x00, 0x40, 0x00,
        0x40, 0x00, 0x40, 0x00, 0x60, 0x00, 0x38, 0x00,
        0x00, 0x00, 0x00, 0x00
    }}, // 't' (width: 5)
    {117,  8, {
        0x00, 0x00, 0x00, 0x00, 0x00, 0x00, 0x00, 0x00,
        0x00, 0x00, 0x42, 0x00, 0x42, 0x00, 0x42, 0x00,
        0x42, 0x00, 0x42, 0x00, 0x66, 0x00, 0x3A, 0x00,
        0x00, 0x00, 0x00, 0x00
    }}, // 'u' (width: 8)
    {118,  8, {
        0x00, 0x00, 0x00, 0x00, 0x00, 0x00, 0x00, 0x00,
        0x00, 0x00, 0x0C, 0x00, 0x88, 0x00, 0x88, 0x00,
        0xD0, 0x00, 0x50, 0x00, 0x70, 0x00, 0x20, 0x00,
        0x00, 0x00, 0x00, 0x00
    }}, // 'v' (width: 8)
    {119, 11, {
        0x00, 0x00, 0x00, 0x00, 0x00, 0x00, 0x00, 0x00,
        0x00, 0x00, 0x84, 0x20, 0x4C, 0x40, 0x4A, 0x40,
        0x4A, 0x40, 0x32, 0x80, 0x31, 0x80, 0x31, 0x80,
        0x00, 0x00, 0x00, 0x00
    }}, // 'w' (width: 11)
    {120,  7, {
        0x00, 0x00, 0x00, 0x00, 0x00, 0x00, 0x00, 0x00,
        0x00, 0x00, 0xC4, 0x00, 0x68, 0x00, 0x38, 0x00,
        0x10, 0x00, 0x38, 0x00, 0x68, 0x00, 0xC4, 0x00,
        0x00, 0x00, 0x00, 0x00
    }}, // 'x' (width: 7)
    {121,  8, {
        0x00, 0x00, 0x00, 0x00, 0x00, 0x00, 0x00, 0x00,
        0x00, 0x00, 0x0C, 0x00, 0x88, 0x00, 0x88, 0x00,
        0x90, 0x00, 0x50, 0x00, 0x50, 0x00, 0x60, 0x00,
        0x20, 0x00, 0x40, 0x00
    }}, // 'y' (width: 8)
    {122,  6, {
        0x00, 0x00, 0x00, 0x00, 0x00, 0x00, 0x00, 0x00,
        0x00, 0x00, 0x7C, 0x00, 0x08, 0x00, 0x10, 0x00,
        0x30, 0x00, 0x20, 0x00, 0x40, 0x00, 0xFC, 0x00,
        0x00, 0x00, 0x00, 0x00
    }}, // 'z' (width: 6)
    {123,  4, {
        0x00, 0x00, 0x00, 0x00, 0x30, 0x00, 0x20, 0x00,
        0x20, 0x00, 0x20, 0x00, 0x20, 0x00, 0x20, 0x00,
        0x40, 0x00, 0x20, 0x00, 0x20, 0x00, 0x20, 0x00,
        0x20, 0x00, 0x20, 0x00
    }}, // '{' (width: 4)
    {124,  4, {
        0x00, 0x00, 0x00, 0x00, 0x40, 0x00, 0x40, 0x00,
        0x40, 0x00, 0x40, 0x00, 0x40, 0x00, 0x40, 0x00,
        0x40, 0x00, 0x40, 0x00, 0x40, 0x00, 0x40, 0x00,
        0x40, 0x00, 0x40, 0x00
    }}, // '|' (width: 4)
    {125,  4, {
        0x00, 0x00, 0x00, 0x00, 0xC0, 0x00, 0x60, 0x00,
        0x60, 0x00, 0x60, 0x00, 0x60, 0x00, 0x60, 0x00,
        0x30, 0x00, 0x60, 0x00, 0x60, 0x00, 0x60, 0x00,
        0x60, 0x00, 0x60, 0x00
    }}, // '}' (width: 4)
    {126,  7, {
        0x00, 0x00, 0x00, 0x00, 0x00, 0x00, 0x00, 0x00,
        0x00, 0x00, 0x00, 0x00, 0x74, 0x00, 0x5C, 0x00,
        0x00, 0x00, 0x00, 0x00, 0x00, 0x00, 0x00, 0x00,
        0x00, 0x00, 0x00, 0x00
    }}, // '~' (width: 7)
    {127,  7, {
        0x00, 0x00, 0x00, 0x00, 0x00, 0x00, 0xFE, 0x00,
        0x82, 0x00, 0x82, 0x00, 0x82, 0x00, 0x82, 0x00,
        0x82, 0x00, 0x82, 0x00, 0x82, 0x00, 0xFE, 0x00,
        0x00, 0x00, 0x00, 0x00
    }} // \x7F (width: 7)
};

#endif // FONT_MONTSERRAT_12_H
```

## src/renderer.h
```c
#ifndef RENDERER_H
#define RENDERER_H

#include "microui.h"


mu_Context *r_get_context(void);

void r_init(void);
void r_draw_rect(mu_Rect rect, mu_Color color);
void r_draw_text(const char *text, mu_Vec2 pos, mu_Color color);
void r_draw_icon(int id, mu_Rect rect, mu_Color color);
 int r_get_text_width(const char *text, int len);
 int r_get_text_height(void);
void r_set_clip_rect(mu_Rect rect);
void r_clear(mu_Color color);
void r_present(void);

#endif
```

## src/zephyr_renderer.c
```c
#include <zephyr/kernel.h>
#include <zephyr/display/cfb.h>
#include <zephyr/drivers/display.h>
#include <zephyr/input/input.h>
#include <string.h>
#include "renderer.h"

#include <zephyr/logging/log.h>
LOG_MODULE_REGISTER(microui_renderer, LOG_LEVEL_INF);

#define DISPLAY_NODE DT_CHOSEN(zephyr_display)
#define DISPLAY_WIDTH DT_PROP(DISPLAY_NODE, width)
#define DISPLAY_HEIGHT DT_PROP(DISPLAY_NODE, height)
#define DISPLAY_PIXEL_FORMAT PIXEL_FORMAT_RGB_888

#define DISPLAY_BUFFER_SIZE (4 * DISPLAY_WIDTH * DISPLAY_HEIGHT)

static const struct device *display_dev = DEVICE_DT_GET(DISPLAY_NODE);
static uint8_t display_buffer[DISPLAY_BUFFER_SIZE] __aligned(4);

// Clipping rectangle
static mu_Rect clip_rect = {0, 0, 0, 0};
static bool has_clip_rect = false;

static mu_Context mu_ctx;

// Font implementation
#include "font_generated.h"

typedef struct {
    uint32_t x;
    uint32_t y;
    bool pressed;
} pointer_input_data;

static pointer_input_data pointer_data = {0, 0};

static const FontGlyph* find_glyph(uint32_t unicode) {
    // Check if character is in our supported range
    if (unicode < FONT_FIRST_CHAR || unicode > FONT_LAST_CHAR) {
        return NULL;
    }
    return &font_data[unicode - FONT_FIRST_CHAR];
}

// Helper function to convert mu_Color to display-specific pixel format
static uint32_t color_to_pixel(mu_Color color) {
    switch (DISPLAY_PIXEL_FORMAT) {
        case PIXEL_FORMAT_RGB_888:
            return (color.r << 16) | (color.g << 8) | color.b;
            
        case PIXEL_FORMAT_ARGB_8888:
            return (color.a << 24) | (color.r << 16) | (color.g << 8) | color.b;
            
        case PIXEL_FORMAT_RGB_565:
            return ((color.r & 0xF8) << 8) | ((color.g & 0xFC) << 3) | (color.b >> 3);
            
        case PIXEL_FORMAT_BGR_565:
            return ((color.b & 0xF8) << 8) | ((color.g & 0xFC) << 3) | (color.r >> 3);
            
        case PIXEL_FORMAT_MONO01:
        case PIXEL_FORMAT_MONO10: {
            // Calculate luminance (0.299*R + 0.587*G + 0.114*B)
            uint8_t luma = (299 * color.r + 587 * color.g + 114 * color.b) / 1000;
            if (DISPLAY_PIXEL_FORMAT == PIXEL_FORMAT_MONO01) {
                return (luma > 127) ? 1 : 0;
            } else {
                return (luma > 127) ? 0 : 1;
            }
        }
        
        case PIXEL_FORMAT_L_8:
            // 8-bit grayscale
            return (299 * color.r + 587 * color.g + 114 * color.b) / 1000;
            
        default:
            return 0;
    }
    return 0;
}

// Set a pixel in the display buffer
static void set_pixel(int x, int y, mu_Color color) {
    // Check display bounds
    if (x < 0 || y < 0 || x >= DISPLAY_WIDTH || y >= DISPLAY_HEIGHT) {
        return;
    }
    
    // Check clip rect
    if (has_clip_rect) {
        if (x < clip_rect.x || y < clip_rect.y ||
            x >= clip_rect.x + clip_rect.w ||
            y >= clip_rect.y + clip_rect.h) {
            return;
        }
    }
    
    uint32_t pixel = color_to_pixel(color);
    
    switch (DISPLAY_PIXEL_FORMAT) {
        case PIXEL_FORMAT_RGB_888: {
            int index = (y * DISPLAY_WIDTH + x) * 3;
            display_buffer[index + 0] = (pixel >> 16) & 0xFF; // R
            display_buffer[index + 1] = (pixel >> 8) & 0xFF;  // G
            display_buffer[index + 2] = pixel & 0xFF;         // B
            break;
        }
        
        case PIXEL_FORMAT_ARGB_8888: {
            int index = (y * DISPLAY_WIDTH + x) * 4;
            display_buffer[index + 0] = (pixel >> 24) & 0xFF; // A
            display_buffer[index + 1] = (pixel >> 16) & 0xFF; // R
            display_buffer[index + 2] = (pixel >> 8) & 0xFF;  // G
            display_buffer[index + 3] = pixel & 0xFF;         // B
            break;
        }
        
        case PIXEL_FORMAT_RGB_565:
        case PIXEL_FORMAT_BGR_565: {
            int index = (y * DISPLAY_WIDTH + x) * 2;
            display_buffer[index + 0] = (pixel >> 8) & 0xFF;
            display_buffer[index + 1] = pixel & 0xFF;
            break;
        }
        
        case PIXEL_FORMAT_MONO01:
        case PIXEL_FORMAT_MONO10: {
            int index = y * ((DISPLAY_WIDTH + 7) / 8) + (x / 8);
            uint8_t bit_pos = 7 - (x % 8);
            
            if (pixel) {
                display_buffer[index] |= (1 << bit_pos);
            } else {
                display_buffer[index] &= ~(1 << bit_pos);
            }
            break;
        }
        
        case PIXEL_FORMAT_L_8: {
            display_buffer[y * DISPLAY_WIDTH + x] = pixel & 0xFF;
            break;
        }
    }
}

static void draw_char(char c, int x, int y, mu_Color color) {
    const FontGlyph* glyph = find_glyph((uint32_t)c);
    if (!glyph) return;
    
    for (int row = 0; row < FONT_HEIGHT; row++) {
        // Handle different bitmap widths
        if (FONT_BITMAP_WIDTH <= 8) {
            uint8_t row_data = glyph->bitmap[row];
            for (int col = 0; col < glyph->width && col < FONT_BITMAP_WIDTH; col++) {
                if (row_data & (0x80 >> col)) {
                    set_pixel(x + col, y + row, color);
                }
            }
        } else if (FONT_BITMAP_WIDTH <= 16) {
            uint16_t row_data = (glyph->bitmap[row * 2] << 8) | glyph->bitmap[row * 2 + 1];
            for (int col = 0; col < glyph->width && col < FONT_BITMAP_WIDTH; col++) {
                if (row_data & (0x8000 >> col)) {
                    set_pixel(x + col, y + row, color);
                }
            }
        } else { // FONT_BITMAP_WIDTH <= 32
            uint32_t row_data = (glyph->bitmap[row * 4] << 24) | 
                               (glyph->bitmap[row * 4 + 1] << 16) |
                               (glyph->bitmap[row * 4 + 2] << 8) | 
                               glyph->bitmap[row * 4 + 3];
            for (int col = 0; col < glyph->width && col < FONT_BITMAP_WIDTH; col++) {
                if (row_data & (0x80000000 >> col)) {
                    set_pixel(x + col, y + row, color);
                }
            }
        }
    }
}


static void draw_icon_pattern(int id, mu_Rect rect, mu_Color color) {
   
}

void r_init(void) {
    if (!device_is_ready(display_dev)) {
        LOG_ERR("Display device is not ready");
        return;
    }

    display_blanking_off(display_dev);
    
    clip_rect.x = 0;
    clip_rect.y = 0;
    clip_rect.w = DISPLAY_WIDTH;
    clip_rect.h = DISPLAY_HEIGHT;
    has_clip_rect = false;
    
    memset(display_buffer, 0, DISPLAY_BUFFER_SIZE);
    
    LOG_INF("MicroUI renderer initialized for %dx%d display", DISPLAY_WIDTH, DISPLAY_HEIGHT);
}

void r_draw_rect(mu_Rect rect, mu_Color color) {
    // Draw rectangle (filled)
    for (int y = rect.y; y < rect.y + rect.h; y++) {
        for (int x = rect.x; x < rect.x + rect.w; x++) {
            set_pixel(x, y, color);
        }
    }
}

void r_draw_text(const char *text, mu_Vec2 pos, mu_Color color) {
    int x = pos.x;
    
    while (*text) {
        const FontGlyph* glyph = find_glyph((uint32_t)*text);
        if (glyph) {
            draw_char(*text, x, pos.y, color);
            x += glyph->width + FONT_CHAR_SPACING;  // Use actual character width
        } else {
            x += FONT_DEFAULT_WIDTH + FONT_CHAR_SPACING;  // Fallback width
        }
        text++;
    }
}

void r_draw_icon(int id, mu_Rect rect, mu_Color color) {

}

 int r_get_text_width(const char *text, int len){
    int width = 0;
    int char_count = 0;
    
    while (char_count < len) {
        const FontGlyph* glyph = find_glyph((uint32_t)*text);
        if (glyph) {
            width += glyph->width;
        } else {
            width += FONT_DEFAULT_WIDTH;
        }
        char_count++;
        text++;
    }
    
    // Add spacing between characters (but not after the last one)
    if (char_count > 0) {
        width += (char_count - 1) * FONT_CHAR_SPACING;
    }
    
    return width;
}

int r_get_text_height(void) {
    return FONT_HEIGHT;
}

void r_set_clip_rect(mu_Rect rect) {
    clip_rect = rect;
    has_clip_rect = true;
    
    if (clip_rect.x < 0) {
        clip_rect.w += clip_rect.x;
        clip_rect.x = 0;
    }
    
    if (clip_rect.y < 0) {
        clip_rect.h += clip_rect.y;
        clip_rect.y = 0;
    }
    
    if (clip_rect.x + clip_rect.w > DISPLAY_WIDTH) {
        clip_rect.w = DISPLAY_WIDTH - clip_rect.x;
    }
    
    if (clip_rect.y + clip_rect.h > DISPLAY_HEIGHT) {
        clip_rect.h = DISPLAY_HEIGHT - clip_rect.y;
    }
}

void r_clear(mu_Color color) {
    for (int y = 0; y < DISPLAY_HEIGHT; y++) {
        for (int x = 0; x < DISPLAY_WIDTH; x++) {
            set_pixel(x, y, color);
        }
    }
}

void r_present(void) {
    static struct display_buffer_descriptor desc = {
        .buf_size = DISPLAY_BUFFER_SIZE,
        .width = DISPLAY_WIDTH,
        .height = DISPLAY_HEIGHT,
        .pitch = DISPLAY_WIDTH,
        .frame_incomplete = false,
    };
    display_write(display_dev, 0, 0, &desc, display_buffer);
}

mu_Context *r_get_context(void) {
    return &mu_ctx;
}

static void microui_input_handler(struct input_event *evt, void *user_data){
    switch(evt->code){
        case INPUT_ABS_X:
            pointer_data.x = evt->value;
            break;
        case INPUT_ABS_Y:
            pointer_data.y = evt->value;
            break;
        case INPUT_BTN_TOUCH:
            if(evt->value) {
                pointer_data.pressed = true;
            } else {
                pointer_data.pressed = false;
            }
            break;
    }

    if(!evt->sync){
        return;
    }

    if(pointer_data.pressed) {
        mu_input_mousedown(&mu_ctx, pointer_data.x, pointer_data.y, MU_MOUSE_LEFT);
    } else {
        mu_input_mouseup(&mu_ctx, pointer_data.x, pointer_data.y, MU_MOUSE_LEFT);
    }
    mu_input_mousemove(&mu_ctx, pointer_data.x, pointer_data.y);
}

INPUT_CALLBACK_DEFINE(NULL, microui_input_handler, NULL);
```

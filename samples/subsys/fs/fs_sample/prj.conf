## Kconfig
```
#
# Copyright (c) 2023 Nordic Semiconductor ASA
# Copyright (c) 2023 Antmicro <www.antmicro.com>
#
# SPDX-License-Identifier: Apache-2.0
#

mainmenu "Filesystems Sample Application"

config FS_SAMPLE_CREATE_SOME_ENTRIES
	bool "When no files are found on mounted partition create some"
	default y
	help
	  In case when no files could be listed, because there are none,
	  "some.dir" directory and "other.txt" file will be created
	  and list will run again to show them. This is useful when
	  showing how file system works on non-SD devices like internal
	  flash or (Q)SPI connected memories, where it is not possible to
	  easily add files with use of other device.

config FS_SAMPLE_FORMAT_DRIVE
	bool "Format drive before mounting"
	depends on FILE_SYSTEM_MKFS
	help
	  If enabled, the sample will format the drive before attempting to mount it.
	  This will erase all existing data on the drive.

source "Kconfig.zephyr"
```

## sample.yaml
```
sample:
  name: Filesystems sample
common:
  tags: filesystem
  modules:
    - fatfs
tests:
  sample.filesystem.fat_fs:
    depends_on: sdhc
    harness: console
    harness_config:
      fixture: fixture_sdhc
      type: multi_line
      regex:
        - "Block count"
        - "Sector size"
        - "Memory Size"
        - "Disk mounted"
  sample.filesystem.fat_fs.overlay:
    platform_allow: nrf52840_blip
  sample.filesystem.fat_fs.adafruit_2_8_tft_touch_v2:
    depends_on:
      - arduino_spi
      - arduino_gpio
      - arduino_i2c
    platform_exclude:
      - stm32f769i_disco
      - pan1781_evb
      - pan1782_evb
      - frdm_k64f
      - mimxrt1010_evk
    extra_args: SHIELD=adafruit_2_8_tft_touch_v2
    tags: shield
    harness: console
    harness_config:
      fixture: fixture_shield_adafruit_2_8_tft_touch_v2
      type: multi_line
      regex:
        - "Block count"
        - "Sector size"
        - "Memory Size"
        - "Disk mounted"
  sample.filesystem.fat_fs.nrf52840dk_nrf52840:
    build_only: true
    platform_allow: nrf52840dk/nrf52840
  sample.filesystem.fat_fs.nrf52840dk_nrf52840_ram_disk:
    build_only: true
    platform_allow: nrf52840dk/nrf52840
    extra_args:
      - EXTRA_CONF_FILE=boards/nrf52840dk_nrf52840_ram_disk.conf
      - DTC_OVERLAY_FILE=boards/nrf52840dk_nrf52840_ram_disk.overlay
  sample.filesystem.fat_fs.nrf52840dk_nrf52840_ram_disk_region:
    build_only: true
    platform_allow: nrf52840dk/nrf52840
    extra_args:
      - EXTRA_CONF_FILE=boards/nrf52840dk_nrf52840_ram_disk.conf
      - DTC_OVERLAY_FILE=boards/nrf52840dk_nrf52840_ram_disk_region.overlay
  sample.filesystem.fat_fs.nrf54l15dk:
    build_only: true
    platform_allow: nrf54l15dk/nrf54l15/cpuapp
  sample.filesystem.fat_fs.ophelia4ev:
    build_only: true
    platform_allow: ophelia4ev/nrf54l15/cpuapp
  sample.filesystem.fat_fs.nrf52840dk_nrf52840.qspi:
    build_only: true
    platform_allow: nrf52840dk/nrf52840
    extra_args:
      - EXTRA_CONF_FILE=boards/nrf52840dk_nrf52840_qspi.conf
      - DTC_OVERLAY_FILE=boards/nrf52840dk_nrf52840_qspi.overlay
  sample.filesystem.fat_fs.has_sdmmc_disk:
    build_only: true
    filter: dt_compat_enabled("zephyr,sdmmc-disk")
    integration_platforms:
      - frdm_k64f
  sample.filesystem.ext2:
    simulation_exclude:
      - renode
    extra_args: CONF_FILE="prj_ext.conf"
    platform_allow:
      - hifive_unmatched/fu740/s7
      - bl5340_dvk/nrf5340/cpuapp
  sample.filesystem.littlefs:
    build_only: true
    extra_args: CONF_FILE="prj_littlefs.conf"
    depends_on: sdhc
    harness: console
    harness_config:
      fixture: fixture_sdhc
      type: multi_line
      regex:
        - "Block count"
        - "Sector size"
        - "Memory Size"
        - "Disk mounted"
  sample.filesystem.littlefs.nrf52840dk_nrf52840:
    build_only: true
    platform_allow: nrf52840dk/nrf52840
    extra_args: EXTRA_CONF_FILE="boards/nrf52840dk_nrf52840_littlefs.conf"
  sample.filesystem.fat_fs.stm32h747i_disco_m7_sdmmc:
    build_only: true
    platform_allow: stm32h747i_disco/stm32h747xx/m7
```

## prj.conf
```kconfig
CONFIG_DISK_ACCESS=y
CONFIG_LOG=y
CONFIG_FILE_SYSTEM=y
CONFIG_FAT_FILESYSTEM_ELM=y
CONFIG_FILE_SYSTEM_MKFS=y
CONFIG_PRINTK=y
CONFIG_MAIN_STACK_SIZE=2048
```

## prj_ext.conf
```kconfig
# Copyright (c) 2023 Antmicro <www.antmicro.com>
# SPDX-License-Identifier: Apache-2.0

CONFIG_LOG=y
CONFIG_LOG_MODE_IMMEDIATE=y

CONFIG_MAIN_STACK_SIZE=2048

CONFIG_FILE_SYSTEM=y
CONFIG_FILE_SYSTEM_EXT2=y
CONFIG_FILE_SYSTEM_MKFS=y

# Enable to allow formatting
# CONFIG_FILE_SYSTEM_MKFS=y
# CONFIG_TEST_RANDOM_GENERATOR=y

CONFIG_DISK_ACCESS=y
CONFIG_DISK_DRIVER_SDMMC=y

# First block of first partition after GPT
CONFIG_EXT2_DISK_STARTING_SECTOR=2082
```

## prj_littlefs.conf
```kconfig
# Copyright (c) 2025 Fabian Blatz <fabianblatz@gmail.com>
# SPDX-License-Identifier: Apache-2.0

CONFIG_DISK_ACCESS=y
CONFIG_LOG=y
CONFIG_PRINTK=y
CONFIG_MAIN_STACK_SIZE=4096

CONFIG_FILE_SYSTEM=y
CONFIG_FILE_SYSTEM_LITTLEFS=y
CONFIG_FILE_SYSTEM_MKFS=y

# Enable LittleFS with block device support
CONFIG_FS_LITTLEFS_BLK_DEV=y
CONFIG_FS_LITTLEFS_FMP_DEV=n

# Enable to create sample directory entries
CONFIG_FS_SAMPLE_CREATE_SOME_ENTRIES=y

# Enable drive formatting before mounting
CONFIG_FS_SAMPLE_FORMAT_DRIVE=y
```

## boards/inkplate_6color_procpu.conf
```kconfig
# SDHC SPI SD card configuration for Inkplate 6Color
CONFIG_SPI=y
CONFIG_SDHC=y
CONFIG_SDMMC_STACK=y
CONFIG_SDMMC_SUBSYS=y
CONFIG_DISK_DRIVER_SDMMC=y

# Enable logging for SD/SDHC/FS debugging
CONFIG_LOG=y
CONFIG_SDHC_LOG_LEVEL_DBG=y
CONFIG_SD_LOG_LEVEL_DBG=y
CONFIG_DISK_LOG_LEVEL_DBG=y
CONFIG_FS_LOG_LEVEL_DBG=y
CONFIG_FAT_FS_LOG_LEVEL_DBG=y

# Increase stack size for filesystem operations
CONFIG_MAIN_STACK_SIZE=4096

# Enable auto-format if no filesystem
CONFIG_FS_FATFS_MOUNT_MKFS=y
```

## src/main.c
```c
/*
 * Copyright (c) 2019 Tavish Naruka <tavishnaruka@gmail.com>
 * Copyright (c) 2023 Nordic Semiconductor ASA
 * Copyright (c) 2023 Antmicro <www.antmicro.com>
 *
 * SPDX-License-Identifier: Apache-2.0
 */

/* Sample which uses the filesystem API and SDHC driver */

#include <zephyr/kernel.h>
#include <zephyr/device.h>
#include <zephyr/storage/disk_access.h>
#include <zephyr/logging/log.h>
#include <zephyr/fs/fs.h>
#include <zephyr/fs/littlefs.h>

#if defined(CONFIG_FAT_FILESYSTEM_ELM)

#include <ff.h>

/*
 *  Note the fatfs library is able to mount only strings inside _VOLUME_STRS
 *  in ffconf.h
 */
#if defined(CONFIG_DISK_DRIVER_MMC)
#define DISK_DRIVE_NAME "SD2"
#else
#define DISK_DRIVE_NAME "SD"
#endif

#define DISK_MOUNT_PT "/"DISK_DRIVE_NAME":"

static FATFS fat_fs;
/* mounting info */
static struct fs_mount_t mp = {
	.type = FS_FATFS,
	.fs_data = &fat_fs,
};

#elif defined(CONFIG_FILE_SYSTEM_EXT2)

#include <zephyr/fs/ext2.h>

#define DISK_DRIVE_NAME "SD"
#define DISK_MOUNT_PT "/ext"

static struct fs_mount_t mp = {
	.type = FS_EXT2,
	.flags = FS_MOUNT_FLAG_NO_FORMAT,
	.storage_dev = (void *)DISK_DRIVE_NAME,
	.mnt_point = "/ext",
};

#elif defined(CONFIG_FILE_SYSTEM_LITTLEFS)

#define DISK_DRIVE_NAME "SD"
#define DISK_MOUNT_PT "/lfs"

static struct fs_littlefs lfs_fs;
static struct fs_mount_t mp = {
	.type = FS_LITTLEFS,
	.fs_data = &lfs_fs,
	.storage_dev = (void *)DISK_DRIVE_NAME,
	.mnt_point = DISK_MOUNT_PT,
	.flags = FS_MOUNT_FLAG_USE_DISK_ACCESS,
};

#endif

#if defined(CONFIG_FAT_FILESYSTEM_ELM)
#define FS_RET_OK FR_OK
#else
#define FS_RET_OK 0
#endif

LOG_MODULE_REGISTER(main);

#define MAX_PATH 128
#define SOME_FILE_NAME "some.dat"
#define SOME_DIR_NAME "some"
#define SOME_REQUIRED_LEN MAX(sizeof(SOME_FILE_NAME), sizeof(SOME_DIR_NAME))

static int lsdir(const char *path);

static int format_drive(void)
{
	int rc;
	
#if defined(CONFIG_FAT_FILESYSTEM_ELM)
	rc = fs_mkfs(FS_FATFS, (uintptr_t)"SD:", NULL, 0);
#elif defined(CONFIG_FILE_SYSTEM_EXT2)
	rc = fs_mkfs(FS_EXT2, (uintptr_t)"SD:", NULL, 0);
#elif defined(CONFIG_FILE_SYSTEM_LITTLEFS)
	rc = fs_mkfs(FS_LITTLEFS, (uintptr_t)"SD:", NULL, 0);
#else
	rc = -ENOTSUP;
#endif

	if (rc < 0) {
		LOG_ERR("Failed to format drive: %d", rc);
		return rc;
	}

	LOG_INF("Drive formatted successfully");
	return 0;
}

static int lsdir(const char *path);
#ifdef CONFIG_FS_SAMPLE_CREATE_SOME_ENTRIES
static bool create_some_entries(const char *base_path)
{
	char path[MAX_PATH];
	struct fs_file_t file;
	int base = strlen(base_path);

	fs_file_t_init(&file);

	if (base >= (sizeof(path) - SOME_REQUIRED_LEN)) {
		LOG_ERR("Not enough concatenation buffer to create file paths");
		return false;
	}

	LOG_INF("Creating some dir entries in %s", base_path);
	strncpy(path, base_path, sizeof(path));

	path[base++] = '/';
	path[base] = 0;
	strcat(&path[base], SOME_FILE_NAME);

	if (fs_open(&file, path, FS_O_CREATE) != 0) {
		LOG_ERR("Failed to create file %s", path);
		return false;
	}
	fs_close(&file);

	path[base] = 0;
	strcat(&path[base], SOME_DIR_NAME);

	if (fs_mkdir(path) != 0) {
		LOG_ERR("Failed to create dir %s", path);
		/* If code gets here, it has at least successes to create the
		 * file so allow function to return true.
		 */
	}
	return true;
}
#endif

static const char *disk_mount_pt = DISK_MOUNT_PT;

int main(void)
{
	/* raw disk i/o */
	do {
		static const char *disk_pdrv = DISK_DRIVE_NAME;
		uint64_t memory_size_mb;
		uint32_t block_count;
		uint32_t block_size;

		if (disk_access_ioctl(disk_pdrv,
				DISK_IOCTL_CTRL_INIT, NULL) != 0) {
			LOG_ERR("Storage init ERROR!");
			break;
		}

		if (disk_access_ioctl(disk_pdrv,
				DISK_IOCTL_GET_SECTOR_COUNT, &block_count)) {
			LOG_ERR("Unable to get sector count");
			break;
		}
		LOG_INF("Block count %u", block_count);

		if (disk_access_ioctl(disk_pdrv,
				DISK_IOCTL_GET_SECTOR_SIZE, &block_size)) {
			LOG_ERR("Unable to get sector size");
			break;
		}
		printk("Sector size %u\n", block_size);

		memory_size_mb = (uint64_t)block_count * block_size;
		printk("Memory Size(MB) %u\n", (uint32_t)(memory_size_mb >> 20));

		if (disk_access_ioctl(disk_pdrv,
				DISK_IOCTL_CTRL_DEINIT, NULL) != 0) {
			LOG_ERR("Storage deinit ERROR!");
			break;
		}
	} while (0);

	mp.mnt_point = disk_mount_pt;

#ifdef CONFIG_FS_SAMPLE_FORMAT_DRIVE
	/* First, format the drive */
	LOG_INF("Formatting drive...");
	int format_res = format_drive();
	if (format_res != 0) {
		LOG_ERR("Failed to format drive, attempting mount anyway");
	}
#endif

	int res = fs_mount(&mp);

	if (res == FS_RET_OK) {
		printk("Disk mounted.\n");
		/* Try to unmount and remount the disk */
		res = fs_unmount(&mp);
		if (res != FS_RET_OK) {
			printk("Error unmounting disk\n");
			return res;
		}
		res = fs_mount(&mp);
		if (res != FS_RET_OK) {
			printk("Error remounting disk\n");
			return res;
		}

		if (lsdir(disk_mount_pt) == 0) {
#ifdef CONFIG_FS_SAMPLE_CREATE_SOME_ENTRIES
			if (create_some_entries(disk_mount_pt)) {
				lsdir(disk_mount_pt);
			}
#endif
		}
	} else {
		printk("Error mounting disk.\n");
	}

	fs_unmount(&mp);

	while (1) {
		k_sleep(K_MSEC(1000));
	}
	return 0;
}

/* List dir entry by path
 *
 * @param path Absolute path to list
 *
 * @return Negative errno code on error, number of listed entries on
 *         success.
 */
static int lsdir(const char *path)
{
	int res;
	struct fs_dir_t dirp;
	static struct fs_dirent entry;
	int count = 0;

	fs_dir_t_init(&dirp);

	/* Verify fs_opendir() */
	res = fs_opendir(&dirp, path);
	if (res) {
		printk("Error opening dir %s [%d]\n", path, res);
		return res;
	}

	printk("\nListing dir %s ...\n", path);
	for (;;) {
		/* Verify fs_readdir() */
		res = fs_readdir(&dirp, &entry);

		/* entry.name[0] == 0 means end-of-dir */
		if (res || entry.name[0] == 0) {
			break;
		}

		if (entry.type == FS_DIR_ENTRY_DIR) {
			printk("[DIR ] %s\n", entry.name);
		} else {
			printk("[FILE] %s (size = %zu)\n",
				entry.name, entry.size);
		}
		count++;
	}

	/* Verify fs_closedir() */
	fs_closedir(&dirp);
	if (res == 0) {
		res = count;
	}

	return res;
}
```
